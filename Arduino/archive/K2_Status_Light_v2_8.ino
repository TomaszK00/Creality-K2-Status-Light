#include <WiFi.h>
#include <WebServer.h>
#include <HTTPClient.h>
#include <Preferences.h>
#include <ESPmDNS.h>
#include <ArduinoJson.h>
#include <Adafruit_NeoPixel.h>
#include <Update.h>

// K2 Status Light v2.7 – FatGiantCat
// Set only after confirming the physical strip wiring. Never connect 24 V to ESP32/LEDs.
#define LED_PIN 4
#define LED_COUNT 24 // physical maximum; select 12 or 24 from the panel
#define STATUS_LED_PIN 8 // ESP32-C3 SuperMini onboard blue LED (active LOW)
#define LED_ENABLED true
const char* AP_NAME = "K2-LED-Setup";
const char* AP_PASSWORD = "k2ledsetup"; // Change before using in public settings.

WebServer server(80);
Preferences prefs;
Adafruit_NeoPixel strip(LED_COUNT, LED_PIN, NEO_GRBW + NEO_KHZ800);
String ssid, wifiPassword, printerIP;
uint16_t printerPort = 7125;
const char* const DEFAULT_ROW_COLORS[6] = {"#00c8f0", "#ff9e35", "#ffce45", "#2fe182", "#ff445c", "#ffffff"};
const char* const stateNames[6] = {"printing", "heating", "paused", "complete", "error", "standby"};
String rowColors[6] = {"#00c8f0", "#ff9e35", "#ffce45", "#2fe182", "#ff445c", "#ffffff"};
uint8_t rowBrightness[6] = {65,65,65,65,65,65};
bool rowPulse[6] = {false,false,false,false,false,false};
uint8_t rowStyle[6] = {0,0,0,0,0,0}; // 0 whole bar, 1 last pair, 2 sweeping light
uint16_t rowPeriod[6] = {1400,1400,1400,1400,1400,1400};
int intervalMs = 500;
int activeLedCount = 24;
uint32_t lastPulseFrame = 0;
bool simLoop = false;
String printerState = "unknown", printerFile = "";
float printerProgress = 0;
bool printerConnected = false;
String lastError = "Waiting for first poll";
uint32_t lastPoll = 0, lastSimulationStep = 0;
bool apMode = false, simEnabled = false, simRun = false;
int simStatus = 0, simProgress = 0;
String updateError = "";

const char PAGE[] PROGMEM = R"HTML(
<!doctype html><html lang="en"><head><meta charset="utf-8"><meta name="viewport" content="width=device-width,initial-scale=1"><title>K2 Status Light · FatGiantCat</title>
<style>
:root{font-family:Inter,system-ui,-apple-system,Segoe UI,sans-serif;color-scheme:light;--bg:#f5f7f6;--panel:#fff;--field:#fff;--border:#dce3df;--text:#181d1a;--muted:#65736b;--green:#20b461}*{box-sizing:border-box}body{margin:0;background:var(--bg);color:var(--text)}main{max-width:1100px;margin:auto;padding:24px 18px 44px}header,.headbar{display:flex;justify-content:space-between;align-items:center;gap:14px;flex-wrap:wrap}header{margin-bottom:24px;padding:12px 0;border-bottom:1px solid var(--border)}h1{font-size:clamp(22px,3vw,30px);margin:0;font-weight:700}h1 span,.brand{color:var(--green)}h2{font-size:17px;margin:0 0 17px}p{margin:9px 0}.muted,small{font-size:13px;color:var(--muted)}.card{background:var(--panel);border:1px solid var(--border);border-radius:12px;padding:22px;margin-bottom:17px}.cols{display:grid;grid-template-columns:1fr 1fr;gap:17px}.chips{display:flex;gap:8px;flex-wrap:wrap;margin-top:10px}.chip{background:#edf5f0;padding:6px 11px;border-radius:6px;font-size:13px}.chip.ok{color:#137a43}.chip.error{color:#b53737}label{display:block;margin:13px 0 6px;color:#26362c;font-size:13px}input,select,button{font:inherit}input:not([type=color]):not([type=range]):not([type=checkbox]):not([type=file]),select{display:block;width:100%;max-width:340px;background:var(--field);border:1px solid #b8c7be;color:#18241c;border-radius:7px;padding:8px 10px;min-height:39px}input[type=number]{max-width:130px!important}#ip{max-width:205px}#ssid,#pass{max-width:300px}#wifiList{max-width:310px}input[type=color]{width:60px;height:37px;border:1px solid #96a79b;border-radius:7px;cursor:pointer;background:var(--field);padding:2px}input[type=range]{width:100%;accent-color:var(--green)}.fields{display:grid;grid-template-columns:repeat(2,minmax(0,1fr));gap:4px 18px}.colorrow{display:grid;grid-template-columns:minmax(110px,1fr) 60px 80px;gap:8px;align-items:center;margin:8px 0}.colorrow label{margin:0}.colorcode{font:12px monospace;color:var(--muted)}button{border:1px solid var(--green);border-radius:7px;background:var(--green);color:#fff;font-weight:700;padding:9px 14px;cursor:pointer}button.alt{background:#edf5f0;color:#245536;border-color:#bfd4c6}button.ghost{background:transparent;color:#356344;border-color:#a9c7b2}button.active{border-color:var(--green);color:#147a42;background:#e3f6e9}button:disabled{opacity:.5}[hidden]{display:none!important}footer a{color:inherit;text-decoration:underline}.langs{display:flex;gap:5px;flex-wrap:wrap}.langs button{padding:6px 9px;font-size:13px}.bar{display:grid;grid-template-columns:repeat(12,minmax(0,1fr));gap:7px;margin:18px 0 9px}.pair{display:grid;grid-template-columns:1fr 1fr;gap:3px}.led{height:28px;border-radius:4px;background:#e3ebe5;transition:background .12s}.pct{font-size:34px;font-weight:750}.controls{display:flex;flex-wrap:wrap;gap:8px;margin-top:14px}.notice{min-height:20px;color:#16864a;font-size:13px}.switch{display:flex;align-items:center;gap:9px;margin:12px 0}.switch label{margin:0}.switch input{width:18px;height:18px;accent-color:var(--green)}.switches{display:flex;gap:20px;flex-wrap:wrap}.checks{display:grid;grid-template-columns:repeat(2,minmax(0,1fr));gap:0 10px;border:1px solid var(--border);border-radius:7px;margin:15px 0;padding:8px 12px}.checks legend{font-size:13px;color:var(--muted);padding:0 5px}.checks .switch{margin:5px 0}hr{border:0;border-top:1px solid var(--border);margin:19px 0}.spaced{margin-top:15px}.scanrow{display:flex;gap:8px;align-items:end}.scanrow select{flex:1}.warning{color:#8e5b19}footer{text-align:center;color:var(--muted);font-size:13px;margin-top:24px}input[type=file]{display:block;max-width:100%;margin:12px 0}@media(max-width:750px){.cols{grid-template-columns:1fr}main{padding:12px}.card{padding:16px}.fields{grid-template-columns:1fr}.bar{gap:3px}.led{height:22px}.colorrow{grid-template-columns:minmax(105px,1fr) 60px 75px}}
.app-header{display:grid;grid-template-columns:1fr auto 1fr;align-items:center}.app-header .brand-title{text-align:center}.app-header .langs{justify-self:end}.app-header .network-open{justify-self:start}.led-card{width:100%}.led-head,.led-row{display:grid;grid-template-columns:minmax(130px,1.2fr) 78px 110px 90px 125px minmax(160px,1.2fr);gap:10px;align-items:center}.led-head{color:var(--muted);font-size:12px;font-weight:700;padding:7px 10px}.led-row{border-top:1px solid var(--border);padding:10px}.led-row:first-child{border-top:0}.led-row label{margin:0;font-weight:600}.led-row input[type=number],.led-row select{max-width:100%!important}.led-row .switch{margin:0}.led-row .field-label{display:none}.led-card .global-fields{display:flex;gap:18px;flex-wrap:wrap;margin-bottom:12px}.led-card .global-fields>div{width:160px}.led-card .global-fields input,.led-card .global-fields select{max-width:160px!important}dialog{width:min(560px,calc(100% - 24px));max-height:calc(100vh - 36px);overflow:auto;border:1px solid var(--border);border-radius:13px;padding:22px;background:#fff;color:var(--text);box-shadow:0 20px 60px #15291b44}dialog::backdrop{background:#14261a99}.dialog-head{display:flex;align-items:center;justify-content:space-between;gap:10px}.toasts{position:fixed;right:16px;bottom:16px;display:grid;gap:9px;z-index:100;max-width:min(380px,calc(100vw - 32px))}.toast{background:#fff;border:1px solid var(--border);border-left:4px solid var(--green);box-shadow:0 7px 22px #172d1d2b;border-radius:8px;padding:11px 14px;font-size:13px}.toast.error{border-left-color:#dd5555}.toast button{float:right;padding:0 3px;margin-left:12px;border:0;background:none;color:var(--muted)}@media(max-width:850px){.app-header{grid-template-columns:1fr auto}.app-header .brand-title{grid-column:1/-1;grid-row:1}.app-header .network-open{grid-row:2}.app-header .langs{grid-row:2}.led-head{display:none}.led-row{grid-template-columns:repeat(2,minmax(0,1fr));gap:10px}.led-row .row-title{grid-column:1/-1}.led-row .field-label{display:block;font-size:12px;color:var(--muted);font-weight:400;margin:0 0 3px}.led-row>div{min-width:0}}@media(max-width:500px){.led-row{grid-template-columns:1fr 1fr}.led-card .global-fields>div{width:calc(50% - 9px)}.langs button{padding:5px}.toasts{right:10px;bottom:10px}}
</style></head><body><main>
<header class="app-header"><button type="button" class="alt network-open" id="openNetwork" data-i="networkSettings">Network and printer</button><div class="brand-title"><h1><span>K2</span> Status Light</h1><div class="muted">FatGiantCat</div></div><nav class="langs" aria-label="Language"><button type="button" id="en" onclick="setLang('en')">🇬🇧 EN</button><button type="button" id="pl" onclick="setLang('pl')">🇵🇱 PL</button><button type="button" id="es" onclick="setLang('es')">🇪🇸 ES</button><button type="button" id="de" onclick="setLang('de')">🇩🇪 DE</button></nav></header>
<section class="card"><div class="headbar"><div><h2 data-i="preview">LED preview and test</h2><small class="muted" data-i="simHint">The test also controls connected LEDs.</small></div></div><div class="chips"><span id="displaystate" class="chip">…</span><span id="file" class="chip"></span></div><div class="headbar spaced"><span class="pct" id="percent">0%</span><span class="muted" id="ledcount">0 / 12</span></div><div class="bar" id="bar"></div><hr>
<div class="switches"><div class="switch"><input type="checkbox" id="sim" onchange="simToggle()"><label for="sim" data-i="testMode">Test mode (overrides printer)</label></div><div class="switch"><input type="checkbox" id="simLoop" onchange="sendSimulation()"><label for="simLoop" data-i="loopTest">Repeat test after 100%</label></div></div><div class="fields"><div><label for="testStatus" data-i="testStatus">Test state</label><select id="testStatus" onchange="testStatusChanged()"><option value="printing" data-i="printing">Printing</option><option value="heating" data-i="heating">Heating</option><option value="paused" data-i="paused">Paused</option><option value="complete" data-i="complete">Completed</option><option value="error" data-i="error">Error</option><option value="standby" data-i="standby">Idle</option></select></div><div><label for="manualProgress"><span data-i="testProgress">Test progress</span>: <span id="manualPct">0%</span></label><input type="range" min="0" max="100" value="0" id="manualProgress" oninput="document.getElementById('manualPct').textContent=this.value+'%';sendSimulation()"><div class="switch"><input type="checkbox" id="autoProgress" onchange="toggleAutoProgress()"><label for="autoProgress" data-i="autoProgress">Play progress automatically</label></div></div></div><p id="simMessage" class="notice"></p></section>
<section class="card led-card"><h2 data-i="lighting">Colours and LED settings</h2><form id="lightForm"><div class="led-head"><span data-i="function">Function</span><span data-i="colour">Colour</span><span data-i="brightness">Brightness (%)</span><span data-i="pulsing">Pulse?</span><span data-i="pulsePeriod">Pulse cycle (ms)</span><span data-i="effect">Effect</span></div><div id="ledRows"></div><hr><div class="global-fields"><div><label for="ledCount" data-i="ledCount">Physical LEDs</label><select name="ledCount" id="ledCount"><option value="24" data-i="led24">24 LED · 12 pairs</option><option value="12" data-i="led12">12 LED · 6 pairs</option></select></div></div><p class="muted" data-i="powerHint">Check LED power wiring before increasing brightness.</p><button type="button" class="ghost" id="resetColors" data-i="resetLights">Restore default LED settings</button><p id="lightMessage" class="notice"></p></form></section>
<section class="card"><h2 data-i="updateTitle">Firmware update · OTA</h2><p class="muted" data-i="updateHint">Select the compiled ESP32-C3 .bin file. Update takes about 2 minutes. Keep power connected and do not close this page.</p><div class="controls"><button type="button" class="alt" id="checkGitHub" data-i="checkUpdates">Check GitHub for updates</button><button type="button" id="installGitHub" data-i="installUpdate" hidden>Install update</button></div><p id="githubMessage" class="muted" aria-live="polite"></p><form id="fwform"><input required id="bin" type="file" accept=".bin,application/octet-stream"><button type="submit" data-i="upload">Upload and restart</button></form><p id="fwMessage" class="notice"></p><p class="muted warning" data-i="security">The panel and OTA have no login. Use only on a trusted local network; do not expose it to the Internet.</p></section>
<footer><a href="https://github.com/TomaszK00/Creality-K2-Status-Light" target="_blank" rel="noopener noreferrer">GitHub · K2 Status Light</a></footer>
<dialog id="networkDialog" aria-labelledby="networkTitle"><div class="dialog-head"><h2 id="networkTitle" data-i="networkSettings">Network and printer</h2><button type="button" class="ghost" id="closeNetwork" data-i="close">Close</button></div><form id="networkForm"><label for="wifiList" data-i="scanWifi">Available 2.4 GHz Wi-Fi</label><div class="scanrow"><select id="wifiList" onchange="if(this.value)document.getElementById('ssid').value=this.value"><option data-i="scanFirst">Scan first</option></select><button type="button" class="alt" onclick="scanWifi()" data-i="scan">Scan</button></div><label for="ssid" data-i="wifiName">Wi-Fi name (SSID)</label><input id="ssid" name="ssid" maxlength="32"><label for="pass" data-i="wifiPass">Wi-Fi password (blank keeps saved)</label><input id="pass" name="pass" type="password" autocomplete="new-password"><label for="ip" data-i="printerIP">Printer IP address</label><input id="ip" name="ip" required><label for="port" data-i="moonPort">Moonraker port</label><input id="port" name="port" type="number" min="1" max="65535" required><div class="controls"><button data-i="saveNetwork" type="submit">Save network settings</button></div><p class="muted" data-i="wifiChangeHint">To switch Wi-Fi: select the new network, enter its password, save, then press RESET on the ESP32. Reopen the panel on the new network. If it cannot connect, use K2-LED-Setup at 192.168.4.1.</p><p id="netMessage" class="notice"></p></form></dialog></main><div class="toasts" id="toasts" aria-live="polite"></div><script>
const T={
en:{networkSaved:'Network settings saved',networkRestart:'Saved. Press RESET to connect to the new Wi-Fi.',invalidMoonraker:'Invalid Moonraker URL',missingFields:'Missing printer fields',invalidNetwork:'Invalid IP, port or SSID',invalidLedCount:'Invalid LED count',invalidLedRow:'Invalid LED settings',noSpace:'Not enough OTA space. Flash once via USB with the min_spiffs partition layout.',led24:'24 LEDs · 12 pairs',led12:'12 LEDs · 6 pairs',moonPort:'Moonraker port',setupOffline:'No printer connection (setup AP)',checkUpdates:'Check GitHub for updates',installUpdate:'Install update',checkingUpdates:'Checking GitHub…',noUpdate:'Firmware is up to date',newVersion:'New version available:',githubUnavailable:'Could not check GitHub. Check Internet access and the Software/update.json file.',downloadFirmware:'Downloading firmware from GitHub…',invalidFirmware:'Firmware download does not match the update manifest.',githubConfirm:'Install version {version}? This can take about 2 minutes. Keep power connected and this page open.',centreOut:'Centre → edges → centre',edgesIn:'Edges → centre → edges',wave:'Flowing wave',restarting:'Uploading and restarting…',waiting:'Waiting for ESP32 to return…',retry:'Could not confirm the restart. Check the device and reload the page.',deviceOffline:'Connection to ESP32 lost',function:'Function',colour:'Colour',pulsing:'Pulse?',effect:'Effect',allBar:'Whole bar',lastPair:'Last pair',scanner:'Scanner (Knight Rider)',close:'Close',preview:'LED preview and test',testMode:'Test mode (overrides printer)',testStatus:'Test state',testProgress:'Test progress',printing:'Printing',heating:'Heating',paused:'Paused',complete:'Completed',error:'Error',standby:'Idle',run:'▶ Run test',stop:'■ Stop',reset:'Reset',loopTest:'Repeat test after 100%',simHint:'The test also controls connected LEDs.',networkSettings:'Network and printer',scanWifi:'Available 2.4 GHz Wi-Fi',scanFirst:'Scan first',scan:'Scan',wifiName:'Wi-Fi name (SSID)',wifiPass:'Wi-Fi password (blank keeps saved)',printerIP:'Printer IP address',saveNetwork:'Save network settings',lighting:'Colours and LED settings',ledCount:'Physical LEDs',brightness:'Brightness (%)',stepTime:'Test step (ms)',pulseMode:'Pulsing mode',pulseOff:'Off',pulseAll:'All lit LEDs',pulseLast:'Last lit pair during printing',pulsePeriod:'Pulse cycle (ms)',powerHint:'Check LED power wiring before increasing brightness.',resetColors:'Restore original colours',saving:'Saving…',wifiChangeHint:'To switch Wi-Fi: select the new network, enter its password, save, then press RESET on the ESP32. Reopen the panel on the new network. If it cannot connect, use K2-LED-Setup at 192.168.4.1.',pulseStages:'Pulse in these states (off by default)',pulseLastPair:'Pulse only the last lit pair while printing',autoProgress:'Play progress automatically',resetLights:'Restore default LED settings',saveLights:'Save LED settings',updateTitle:'Firmware update · OTA',updateHint:'Select the compiled ESP32-C3 .bin file. Update takes about 2 minutes. Keep power connected and do not close this page.',upload:'Upload and restart',security:'The panel and OTA have no login. Use only on a trusted local network; do not expose it to the Internet.',credits:'Designed by',progressColor:'Print progress',colour_printing:'Printing',colour_heating:'Heating',colour_paused:'Paused',colour_complete:'Finished',colour_error:'Error',colour_standby:'Idle',saved:'Settings saved',scanError:'Scan failed',updateDone:'Firmware uploaded; device restarting…',updateFailed:'Upload failed',offline:'Printer offline',connected:'Printer connected',setup:'Setup access point',home:'Local Wi-Fi',test:'TEST',uploadConfirm:'Update can take about 2 minutes. Keep power connected and do not close this page. Upload firmware now?',chooseBin:'Select a .bin file',scanning:'Scanning…'},
pl:{networkSaved:'Zapisano ustawienia sieci',networkRestart:'Zapisano. Naciśnij RESET, aby połączyć się z nową siecią Wi-Fi.',invalidMoonraker:'Nieprawidłowy adres Moonraker',missingFields:'Brakuje danych drukarki',invalidNetwork:'Nieprawidłowy adres IP, port lub SSID',invalidLedCount:'Nieprawidłowa liczba diod LED',invalidLedRow:'Nieprawidłowe ustawienia LED',noSpace:'Za mało miejsca na OTA. Wgraj raz przez USB z układem partycji min_spiffs.',led24:'24 diody LED · 12 par',led12:'12 diod LED · 6 par',moonPort:'Port Moonraker',setupOffline:'Brak połączenia z drukarką (sieć konfiguracyjna)',checkUpdates:'Sprawdź aktualizacje na GitHubie',installUpdate:'Zainstaluj aktualizację',checkingUpdates:'Sprawdzam GitHub…',noUpdate:'Oprogramowanie jest aktualne',newVersion:'Dostępna nowa wersja:',githubUnavailable:'Nie udało się sprawdzić GitHuba. Sprawdź Internet i plik Software/update.json.',downloadFirmware:'Pobieram firmware z GitHuba…',invalidFirmware:'Pobrany firmware nie zgadza się z manifestem aktualizacji.',githubConfirm:'Zainstalować wersję {version}? Może to potrwać około 2 minut. Nie odłączaj zasilania ani nie zamykaj strony.',centreOut:'Środek → boki → środek',edgesIn:'Boki → środek → boki',wave:'Płynąca fala',restarting:'Wgrywanie i uruchamianie ponownie…',waiting:'Czekam na ponowne połączenie z ESP32…',retry:'Nie mogę potwierdzić restartu. Sprawdź urządzenie i odśwież stronę.',deviceOffline:'Utracono połączenie z ESP32',function:'Funkcja',colour:'Kolor',pulsing:'Pulsowanie?',effect:'Efekt',allBar:'Cały pasek',lastPair:'Ostatnia para',scanner:'Wędrujące światło (Knight Rider)',close:'Zamknij',preview:'Podgląd i test LED',testMode:'Tryb testowy (zastępuje drukarkę)',testStatus:'Stan testowy',testProgress:'Postęp testu',printing:'Drukowanie',heating:'Nagrzewanie',paused:'Pauza',complete:'Zakończono',error:'Błąd',standby:'Bezczynność',run:'▶ Uruchom test',stop:'■ Zatrzymaj',reset:'Resetuj',loopTest:'Powtarzaj test po 100%',simHint:'Test steruje także podłączonym paskiem LED.',networkSettings:'Sieć i drukarka',scanWifi:'Dostępne Wi-Fi 2,4 GHz',scanFirst:'Najpierw skanuj',scan:'Skanuj',wifiName:'Nazwa Wi-Fi (SSID)',wifiPass:'Hasło Wi-Fi (puste zachowuje zapisane)',printerIP:'Adres IP drukarki',saveNetwork:'Zapisz ustawienia sieci',lighting:'Kolory i ustawienia LED',ledCount:'Fizyczne diody LED',brightness:'Jasność (%)',stepTime:'Krok testu (ms)',pulseMode:'Tryb pulsowania',pulseOff:'Wyłączone',pulseAll:'Wszystkie zapalone diody',pulseLast:'Ostatnia zapalona para podczas druku',pulsePeriod:'Cykl pulsowania (ms)',powerHint:'Sprawdź zasilanie LED przed zwiększeniem jasności.',resetColors:'Przywróć oryginalne kolory',saving:'Zapisywanie…',wifiChangeHint:'Aby zmienić Wi-Fi: wybierz nową sieć, wpisz jej hasło, zapisz i naciśnij RESET na ESP32. Otwórz panel w nowej sieci. Jeśli połączenie się nie uda, użyj K2-LED-Setup pod 192.168.4.1.',pulseStages:'Pulsuj w tych stanach (domyślnie wyłączone)',pulseLastPair:'Pulsuj tylko ostatnią zapaloną parę podczas druku',autoProgress:'Automatycznie odtwarzaj postęp',resetLights:'Przywróć domyślne ustawienia LED',saveLights:'Zapisz ustawienia LED',updateTitle:'Aktualizacja oprogramowania · OTA',updateHint:'Wybierz plik .bin dla ESP32-C3. Aktualizacja trwa około 2 minut. Nie odłączaj zasilania ani nie zamykaj tej strony.',upload:'Wgraj i uruchom ponownie',security:'Panel i OTA nie mają logowania. Używaj tylko w zaufanej sieci lokalnej; nie udostępniaj w Internecie.',credits:'Projekt:',progressColor:'Postęp druku',colour_printing:'Drukowanie',colour_heating:'Nagrzewanie',colour_paused:'Pauza',colour_complete:'Zakończono',colour_error:'Błąd',colour_standby:'Bezczynność',saved:'Zapisano ustawienia',scanError:'Błąd skanowania',updateDone:'Wgrano firmware; urządzenie uruchamia się ponownie…',updateFailed:'Błąd aktualizacji',offline:'Brak połączenia z drukarką',connected:'Połączono z drukarką',setup:'Sieć konfiguracyjna',home:'Domowe Wi-Fi',test:'TEST',uploadConfirm:'Aktualizacja może potrwać około 2 minut. Nie odłączaj zasilania ani nie zamykaj tej strony. Wgrać firmware?',chooseBin:'Wybierz plik .bin',scanning:'Skanowanie…'},
es:{networkSaved:'Ajustes de red guardados',networkRestart:'Guardado. Pulsa RESET para conectarte a la nueva red Wi-Fi.',invalidMoonraker:'URL de Moonraker no válida',missingFields:'Faltan datos de la impresora',invalidNetwork:'IP, puerto o SSID no válidos',invalidLedCount:'Número de LED no válido',invalidLedRow:'Ajustes LED no válidos',noSpace:'No hay espacio OTA suficiente. Graba una vez por USB con la partición min_spiffs.',led24:'24 LED · 12 pares',led12:'12 LED · 6 pares',moonPort:'Puerto Moonraker',setupOffline:'Sin conexión con la impresora (red de configuración)',checkUpdates:'Buscar actualizaciones en GitHub',installUpdate:'Instalar actualización',checkingUpdates:'Consultando GitHub…',noUpdate:'El firmware está actualizado',newVersion:'Nueva versión disponible:',githubUnavailable:'No se pudo consultar GitHub. Comprueba Internet y Software/update.json.',downloadFirmware:'Descargando firmware de GitHub…',invalidFirmware:'El firmware descargado no coincide con el manifiesto.',githubConfirm:'¿Instalar la versión {version}? Puede tardar unos 2 minutos. Mantén la alimentación y la página abierta.',centreOut:'Centro → extremos → centro',edgesIn:'Extremos → centro → extremos',wave:'Ola en movimiento',restarting:'Subiendo y reiniciando…',waiting:'Esperando a que vuelva el ESP32…',retry:'No se pudo confirmar el reinicio. Comprueba el dispositivo y recarga la página.',deviceOffline:'Se perdió la conexión con ESP32',function:'Función',colour:'Color',pulsing:'¿Pulsar?',effect:'Efecto',allBar:'Toda la barra',lastPair:'Último par',scanner:'Luz móvil (Knight Rider)',close:'Cerrar',preview:'Vista previa y prueba LED',testMode:'Modo de prueba (sustituye la impresora)',testStatus:'Estado de prueba',testProgress:'Progreso de prueba',printing:'Imprimiendo',heating:'Calentando',paused:'En pausa',complete:'Finalizado',error:'Error',standby:'En espera',run:'▶ Iniciar prueba',stop:'■ Detener',reset:'Restablecer',loopTest:'Repetir al llegar al 100%',simHint:'La prueba también controla los LED conectados.',networkSettings:'Red e impresora',scanWifi:'Redes Wi-Fi de 2,4 GHz',scanFirst:'Escanear primero',scan:'Escanear',wifiName:'Nombre Wi-Fi (SSID)',wifiPass:'Contraseña Wi-Fi (vacío conserva la guardada)',printerIP:'Dirección IP de la impresora',saveNetwork:'Guardar ajustes de red',lighting:'Colores y ajustes LED',ledCount:'LED físicos',brightness:'Brillo (%)',stepTime:'Paso de prueba (ms)',pulseMode:'Modo de pulsación',pulseOff:'Desactivado',pulseAll:'Todos los LED encendidos',pulseLast:'Último par encendido al imprimir',pulsePeriod:'Ciclo de pulsación (ms)',powerHint:'Comprueba la alimentación antes de aumentar el brillo.',resetColors:'Restaurar colores originales',saving:'Guardando…',wifiChangeHint:'Para cambiar de Wi-Fi: elige la nueva red, introduce su contraseña, guarda y pulsa RESET en el ESP32. Abre el panel en la nueva red. Si no conecta, usa K2-LED-Setup en 192.168.4.1.',pulseStages:'Pulsar en estos estados (desactivado por defecto)',pulseLastPair:'Pulsar solo el último par encendido al imprimir',autoProgress:'Reproducir el progreso automáticamente',resetLights:'Restaurar ajustes LED predeterminados',saveLights:'Guardar ajustes LED',updateTitle:'Actualizar firmware · OTA',updateHint:'Selecciona el .bin para ESP32-C3. La actualización tarda unos 2 minutos. Mantén la alimentación y no cierres esta página.',upload:'Subir y reiniciar',security:'El panel y OTA no tienen contraseña. Úsalos solo en una red local de confianza; no los expongas a Internet.',credits:'Diseñado por',progressColor:'Progreso de impresión',colour_printing:'Imprimiendo',colour_heating:'Calentando',colour_paused:'En pausa',colour_complete:'Finalizado',colour_error:'Error',colour_standby:'En espera',saved:'Ajustes guardados',scanError:'Error al escanear',updateDone:'Firmware cargado; reiniciando…',updateFailed:'Error al subir',offline:'Impresora desconectada',connected:'Impresora conectada',setup:'Punto de acceso',home:'Wi-Fi local',test:'PRUEBA',uploadConfirm:'La actualización puede tardar unos 2 minutos. Mantén la alimentación y no cierres esta página. ¿Subir firmware?',chooseBin:'Selecciona un archivo .bin',scanning:'Escaneando…'},
de:{networkSaved:'Netzwerkeinstellungen gespeichert',networkRestart:'Gespeichert. RESET drücken, um das neue WLAN zu verbinden.',invalidMoonraker:'Ungültige Moonraker-URL',missingFields:'Druckerdaten fehlen',invalidNetwork:'Ungültige IP, Port oder SSID',invalidLedCount:'Ungültige LED-Anzahl',invalidLedRow:'Ungültige LED-Einstellungen',noSpace:'Zu wenig OTA-Speicher. Einmal per USB mit min_spiffs-Partitionierung flashen.',led24:'24 LEDs · 12 Paare',led12:'12 LEDs · 6 Paare',moonPort:'Moonraker-Port',setupOffline:'Keine Druckerverbindung (Einrichtungsnetz)',checkUpdates:'Auf GitHub nach Updates suchen',installUpdate:'Update installieren',checkingUpdates:'GitHub wird geprüft…',noUpdate:'Firmware ist aktuell',newVersion:'Neue Version verfügbar:',githubUnavailable:'GitHub konnte nicht geprüft werden. Internet und Software/update.json prüfen.',downloadFirmware:'Firmware von GitHub wird geladen…',invalidFirmware:'Geladene Firmware stimmt nicht mit dem Update-Manifest überein.',githubConfirm:'Version {version} installieren? Dies kann etwa 2 Minuten dauern. Stromversorgung und Seite geöffnet lassen.',centreOut:'Mitte → außen → Mitte',edgesIn:'Außen → Mitte → außen',wave:'Fließende Welle',restarting:'Upload und Neustart…',waiting:'Warte auf ESP32…',retry:'Neustart nicht bestätigt. Gerät prüfen und Seite neu laden.',deviceOffline:'Verbindung zum ESP32 verloren',function:'Funktion',colour:'Farbe',pulsing:'Pulsieren?',effect:'Effekt',allBar:'Ganzer Streifen',lastPair:'Letztes Paar',scanner:'Lauflicht (Knight Rider)',close:'Schließen',preview:'LED-Vorschau und Test',testMode:'Testmodus (ersetzt Druckerdaten)',testStatus:'Teststatus',testProgress:'Testfortschritt',printing:'Druckt',heating:'Heizt',paused:'Pausiert',complete:'Abgeschlossen',error:'Fehler',standby:'Bereit',run:'▶ Test starten',stop:'■ Stoppen',reset:'Zurücksetzen',loopTest:'Test nach 100 % wiederholen',simHint:'Der Test steuert auch die angeschlossenen LEDs.',networkSettings:'Netzwerk und Drucker',scanWifi:'Verfügbare 2,4-GHz-WLANs',scanFirst:'Zuerst suchen',scan:'Suchen',wifiName:'WLAN-Name (SSID)',wifiPass:'WLAN-Passwort (leer lässt gespeichert)',printerIP:'IP-Adresse des Druckers',saveNetwork:'Netzwerk speichern',lighting:'Farben und LED-Einstellungen',ledCount:'Physische LEDs',brightness:'Helligkeit (%)',stepTime:'Testschritt (ms)',pulseMode:'Pulsiermodus',pulseOff:'Aus',pulseAll:'Alle leuchtenden LEDs',pulseLast:'Letztes leuchtendes Paar beim Drucken',pulsePeriod:'Pulszyklus (ms)',powerHint:'LED-Stromversorgung vor höherer Helligkeit prüfen.',resetColors:'Originalfarben wiederherstellen',saving:'Speichern…',wifiChangeHint:'WLAN wechseln: Neues Netz wählen, Passwort eingeben, speichern und RESET am ESP32 drücken. Panel im neuen Netz öffnen. Bei Verbindungsfehler K2-LED-Setup unter 192.168.4.1 verwenden.',pulseStages:'In diesen Zuständen pulsieren (standardmäßig aus)',pulseLastPair:'Beim Drucken nur das letzte leuchtende Paar pulsieren lassen',autoProgress:'Fortschritt automatisch abspielen',resetLights:'LED-Standardeinstellungen wiederherstellen',saveLights:'LED-Einstellungen speichern',updateTitle:'Firmware-Update · OTA',updateHint:'ESP32-C3-.bin-Datei auswählen. Das Update dauert etwa 2 Minuten. Strom nicht trennen und diese Seite nicht schließen.',upload:'Hochladen und neu starten',security:'Panel und OTA haben kein Login. Nur in einem vertrauenswürdigen lokalen Netz verwenden; nicht im Internet freigeben.',credits:'Entwickelt von',progressColor:'Druckfortschritt',colour_printing:'Druckt',colour_heating:'Heizt',colour_paused:'Pausiert',colour_complete:'Fertig',colour_error:'Fehler',colour_standby:'Bereit',saved:'Einstellungen gespeichert',scanError:'Suche fehlgeschlagen',updateDone:'Firmware hochgeladen; Neustart…',updateFailed:'Upload fehlgeschlagen',offline:'Drucker offline',connected:'Drucker verbunden',setup:'Einrichtungsnetz',home:'Lokales WLAN',test:'TEST',uploadConfirm:'Das Update kann etwa 2 Minuten dauern. Strom nicht trennen und diese Seite nicht schließen. Firmware hochladen?',chooseBin:'.bin-Datei auswählen',scanning:'Suche läuft…'}};
let lang='en',initialized=false,lastStatus={},simBusy=false,simQueued=null;
function setLang(l){if(!T[l])l='en';lang=l;document.documentElement.lang=l;localStorage.setItem('k2lang',l);document.querySelectorAll('[data-i]').forEach(e=>{e.textContent=T[l][e.dataset.i]||T.en[e.dataset.i]||e.textContent});document.querySelectorAll('[data-aria-i]').forEach(e=>e.setAttribute('aria-label',T[l][e.dataset.ariaI]||T.en[e.dataset.ariaI]));document.querySelectorAll('.toast button').forEach(e=>e.setAttribute('aria-label',T[l].close));for(const id of Object.keys(T).filter(x=>['en','pl','es','de'].includes(x)))document.getElementById(id).classList.toggle('active',l===id);paintStatus(lastStatus);if(availableUpdate)document.getElementById('githubMessage').textContent=T[l].newVersion+' '+availableUpdate.version;if(initialized){lastConnectionKey=null;refresh()}}
const GITHUB_MANIFEST='https://raw.githubusercontent.com/TomaszK00/Creality-K2-Status-Light/main/Software/update.json';
let availableUpdate=null;
const rowIds=['progress','heating','paused','complete','error','standby'];
const rowLabels=['printing','heating','paused','complete','error','standby'];
const rowContainer=document.getElementById('ledRows');
for(const [i,id] of rowIds.entries()){const row=document.createElement('div');row.className='led-row';const effects='<option value="0" data-i="allBar">Whole bar</option><option value="1" data-i="lastPair">Last pair</option><option value="2" data-i="scanner">Scanner (Knight Rider)</option><option value="3" data-i="centreOut">Centre → edges → centre</option><option value="4" data-i="edgesIn">Edges → centre → edges</option><option value="5" data-i="wave">Flowing wave</option>'; row.innerHTML=`<label class="row-title" data-i="${rowLabels[i]}" for="c_${id}"></label><div><span class="field-label" data-i="colour"></span><input type="color" name="c_${id}" id="c_${id}" data-aria-i="colour"></div><div><span class="field-label" data-i="brightness"></span><input type="number" name="b_${id}" id="b_${id}" min="1" max="100" data-aria-i="brightness"></div><div><span class="field-label" data-i="pulsing"></span><input type="checkbox" name="pe_${id}" id="pe_${id}" data-aria-i="pulsing"></div><div><span class="field-label" data-i="pulsePeriod"></span><input type="number" name="pp_${id}" id="pp_${id}" min="200" max="10000" step="100" data-aria-i="pulsePeriod"></div><div><span class="field-label" data-i="effect"></span><select name="ps_${id}" id="ps_${id}" data-aria-i="effect">${effects}</select></div>`;rowContainer.append(row)}
function applyRows(rows){for(const id of rowIds){const r=rows[id];document.getElementById('c_'+id).value=r.color;document.getElementById('b_'+id).value=r.brightness;document.getElementById('pe_'+id).checked=r.pulse;document.getElementById('pp_'+id).value=r.period;document.getElementById('ps_'+id).value=r.style}}
function toast(message,error=false,sticky=false,key=''){if(!message)return;if(key)document.querySelector(`[data-toast-key="${key}"]`)?.remove();const box=document.createElement('div');box.className='toast'+(error?' error':'');if(key)box.dataset.toastKey=key;if(sticky)box.dataset.sticky='true';const close=document.createElement('button');close.type='button';close.textContent='×';close.setAttribute('aria-label',T[lang].close);close.onclick=()=>box.remove();box.append(close,document.createTextNode(message));document.getElementById('toasts').prepend(box);const removable=[...document.querySelectorAll('.toast:not([data-sticky="true"])')];while(document.querySelectorAll('.toast').length>4&&removable.length)removable.pop().remove();if(!sticky)setTimeout(()=>box.remove(),6500)}

document.getElementById('openNetwork').onclick=()=>document.getElementById('networkDialog').showModal();
document.getElementById('closeNetwork').onclick=()=>document.getElementById('networkDialog').close();

function buildBar(pairs){const bar=document.getElementById('bar');if(bar.children.length===pairs)return;bar.replaceChildren();bar.style.gridTemplateColumns=`repeat(${pairs},minmax(0,1fr))`;for(let i=0;i<pairs;i++){const pair=document.createElement('div');pair.className='pair';for(let j=0;j<2;j++){const led=document.createElement('div');led.className='led';pair.append(led)}bar.append(pair)}}
async function api(path,options){const r=await fetch(path,options);if(!r.ok)throw Error(await r.text());return r.json()}
function paintStatus(s){if(!s||!s.rows)return;const state=s.sim?s.simState:(s.connected?s.state:'standby'),id=state==='printing'?'progress':state,prog=s.sim?s.simProgress:s.progress*100,pairs=s.ledCount/2,r=s.rows[id];if(!r)return;const count=state==='printing'?Math.ceil(prog*pairs/100):(state==='standby'&&!r.pulse?0:pairs);buildBar(pairs);const color=document.getElementById('c_'+id)?.value||r.color,bright=Number(document.getElementById('b_'+id)?.value||r.brightness)/100,pulse=document.getElementById('pe_'+id)?.checked??r.pulse,period=Number(document.getElementById('pp_'+id)?.value||r.period),style=Number(document.getElementById('ps_'+id)?.value??r.style);document.getElementById('percent').textContent=Math.round(prog)+'%';document.getElementById('ledcount').textContent=count+' / '+pairs;document.getElementById('displaystate').textContent=(s.sim?T[lang].test+' · ':'')+(T[lang][state]||state);document.getElementById('file').textContent=s.filename||'';document.getElementById('file').style.display=s.filename?'':'none';const cycle=Math.max(200,period),phase=(Date.now()%cycle)/cycle,wave=(1-Math.cos(2*Math.PI*phase))/2,scale=.25+.75*wave,travel=phase*2*Math.max(0,count-1),head=travel<=count-1?travel:2*(count-1)-travel,centre=(count-1)/2,radius=Math.max(.5,centre),outward=1-Math.abs(2*phase-1),front=(style===3?outward:1-outward)*radius;[...document.querySelectorAll('.pair')].forEach((p,i)=>[...p.children].forEach(led=>{const lit=i<count;let level=1;if(pulse&&lit){if(style===2)level=Math.max(.08,1-Math.abs(i-head)/2.2);else if(style===3||style===4)level=Math.max(.08,1-Math.abs(Math.abs(i-centre)-front)/1.3);else if(style===5)level=.16+.84*(.5+.5*Math.cos(2*Math.PI*(i/Math.max(1,count-1)-phase)));else if(style===0||(style===1&&i===count-1))level=scale}led.style.background=lit?color:'#e3ebe5';led.style.opacity=lit?Math.max(.05,bright*level):1;led.style.boxShadow=lit?'0 0 7px '+color+'40':'none'}))}

let lastConnectionKey=null;
async function refresh(){try{const s=await api('/api/status');lastStatus=s;if(!initialized){for(const [id,v] of Object.entries({ssid:s.ssid,ip:s.ip,port:s.port,ledCount:s.ledCount}))document.getElementById(id).value=v;applyRows(s.rows);document.getElementById('testStatus').value=s.simState;document.getElementById('simLoop').checked=s.simLoop;initialized=true}document.getElementById('manualProgress').value=s.simProgress;document.getElementById('manualPct').textContent=s.simProgress+'%';document.getElementById('sim').checked=s.sim;document.getElementById('autoProgress').checked=s.simRunning;paintStatus(s);const key=[s.ap,s.connected,s.connected?'':s.error].join('|');if(key!==lastConnectionKey){lastConnectionKey=key;toast(s.connected?T[lang].connected:(s.ap?T[lang].setupOffline:T[lang].offline+(s.error&&s.error!=='No printer connection (setup AP)'?' · '+localError(s.error):'')),!s.connected,!s.connected,'connection')}}catch(e){if(lastConnectionKey!=='device-offline'){lastConnectionKey='device-offline';toast(T[lang].deviceOffline,true,true,'connection')}}}

function localError(message){if(message==='Invalid Moonraker URL')return T[lang].invalidMoonraker;if(message==='Missing printer fields')return T[lang].missingFields;if(message==='Invalid IP, port or SSID')return T[lang].invalidNetwork;if(message==='Invalid LED count')return T[lang].invalidLedCount;if(message.startsWith('Invalid LED row:'))return T[lang].invalidLedRow;if(message.includes('Not Enough Space'))return T[lang].noSpace;if(message.startsWith('JSON:'))return 'JSON: '+message.slice(5);return message}
async function postForm(path,form){const r=await fetch(path,{method:'POST',body:new URLSearchParams(new FormData(form))});if(!r.ok)throw Error(await r.text());return r.text()}
document.getElementById('networkForm').onsubmit=async e=>{e.preventDefault();try{const msg=await postForm('/api/network',e.target),label=msg.includes('RESET')?T[lang].networkRestart:T[lang].networkSaved;document.getElementById('netMessage').textContent=label;toast(label)}catch(err){document.getElementById('netMessage').textContent=localError(err.message);toast(localError(err.message),true)}};
let lightTimer,lightSaveChain=Promise.resolve(),resettingColors=false;
const lightForm=document.getElementById('lightForm'),lightMessage=document.getElementById('lightMessage');
function scheduleLightSave(){if(resettingColors)return;clearTimeout(lightTimer);lightTimer=setTimeout(saveLightSettings,450)}
function saveLightSettings(){if(resettingColors||!lightForm.checkValidity())return;clearTimeout(lightTimer);lightMessage.textContent=T[lang].saving;lightSaveChain=lightSaveChain.catch(()=>{}).then(async()=>{if(resettingColors)return;try{await postForm('/api/lighting',lightForm);lightMessage.textContent=T[lang].saved;toast(T[lang].saved);await refresh()}catch(err){lightMessage.textContent=localError(err.message);toast(localError(err.message),true)}});return lightSaveChain}
lightForm.addEventListener('input',e=>{if(e.target.type!=='color')scheduleLightSave()});
lightForm.addEventListener('change',scheduleLightSave);
lightForm.onsubmit=e=>{e.preventDefault();saveLightSettings()};
document.getElementById('resetColors').onclick=async()=>{clearTimeout(lightTimer);resettingColors=true;const button=document.getElementById('resetColors');button.disabled=true;try{await lightSaveChain.catch(()=>{});const settings=await api('/api/lighting/defaults',{method:'POST'});document.getElementById('ledCount').value=settings.ledCount;applyRows(settings.rows);lastStatus={...lastStatus,...settings};paintStatus(lastStatus);lightMessage.textContent=T[lang].saved;toast(T[lang].saved)}catch(err){lightMessage.textContent=localError(err.message);toast(localError(err.message),true)}finally{button.disabled=false;resettingColors=false}};

async function scanWifi(){const list=document.getElementById('wifiList');list.replaceChildren(new Option(T[lang].scanning,''));try{const s=await api('/api/wifi/scan');list.replaceChildren(new Option('—',''));s.networks.forEach(n=>list.add(new Option(n.ssid+' ('+n.rssi+' dBm) '+(n.secure?'🔒':''),n.ssid)))}catch(e){list.replaceChildren(new Option(T[lang].scanError,''))}}
async function sendSimulation(extra={}){simQueued={...(simQueued||{}),...extra};if(simBusy)return;simBusy=true;try{while(simQueued){const action=simQueued;simQueued=null;const p=new URLSearchParams({enabled:document.getElementById('sim').checked?'1':'0',status:document.getElementById('testStatus').value,progress:document.getElementById('manualProgress').value,loop:document.getElementById('simLoop').checked?'1':'0',...action});await api('/api/simulation',{method:'POST',body:p});await refresh()}}catch(e){document.getElementById('simMessage').textContent=e.message}finally{simBusy=false}}
function simToggle(){if(!document.getElementById('sim').checked)document.getElementById('autoProgress').checked=false;sendSimulation({run:'0'})}function testStatusChanged(){if(document.getElementById('testStatus').value!=='printing'){document.getElementById('autoProgress').checked=false;sendSimulation({run:'0'})}else sendSimulation()}function toggleAutoProgress(){const play=document.getElementById('autoProgress').checked;if(play){document.getElementById('sim').checked=true;document.getElementById('testStatus').value='printing';document.getElementById('manualProgress').value=0}sendSimulation({run:play?'1':'0',...(play?{progress:'0'}:{})})}
const sleep=ms=>new Promise(resolve=>setTimeout(resolve,ms));
async function waitForRestart(confirmed,startVersion){let wentOffline=false,consecutive=0;const began=Date.now();await sleep(1200);while(Date.now()-began<180000){try{const r=await fetch('/api/status?probe='+Date.now(),{cache:'no-store'});if(!r.ok)throw Error('HTTP '+r.status);const status=await r.json();if(wentOffline||status.version!==startVersion||(confirmed&&Date.now()-began>6000)){if(++consecutive>=2){location.replace('/?updated='+Date.now());return}}}catch(_){wentOffline=true;consecutive=0}await sleep(1800)}throw Error(T[lang].retry)}
// SHA-256 works on the local HTTP panel too, where SubtleCrypto may be unavailable.
function sha256(bytes){
  const primes=[];for(let n=2;primes.length<64;n++){let prime=true;for(let d=2;d*d<=n;d++)if(n%d===0){prime=false;break}if(prime)primes.push(n)}
  const frac=x=>Math.floor((x-Math.floor(x))*4294967296)>>>0;
  const k=primes.map(x=>frac(Math.cbrt(x))),h=primes.slice(0,8).map(x=>frac(Math.sqrt(x)));
  const size=bytes.length,pad=((size+9+63)>>6)<<6,data=new Uint8Array(pad);data.set(bytes);data[size]=128;
  const bitLen=size*8;for(let i=0;i<8;i++)data[pad-1-i]=Math.floor(bitLen/2**(i*8))&255;
  const rr=(v,n)=>(v>>>n)|(v<<(32-n)),w=new Uint32Array(64);
  for(let offset=0;offset<pad;offset+=64){
    for(let i=0;i<16;i++){let j=offset+i*4;w[i]=(data[j]<<24)|(data[j+1]<<16)|(data[j+2]<<8)|data[j+3]}
    for(let i=16;i<64;i++){let a=w[i-15],b=w[i-2];w[i]=(w[i-16]+(rr(a,7)^rr(a,18)^(a>>>3))+w[i-7]+(rr(b,17)^rr(b,19)^(b>>>10)))|0}
    let [a,b,c,d,e,f,g,q]=h;
    for(let i=0;i<64;i++){let t1=(q+(rr(e,6)^rr(e,11)^rr(e,25))+((e&f)^(~e&g))+k[i]+w[i])|0,t2=((rr(a,2)^rr(a,13)^rr(a,22))+((a&b)^(a&c)^(b&c)))|0;q=g;g=f;f=e;e=(d+t1)|0;d=c;c=b;b=a;a=(t1+t2)|0}
    [a,b,c,d,e,f,g,q].forEach((v,i)=>h[i]=(h[i]+v)|0)
  }
  return h.map(x=>(x>>>0).toString(16).padStart(8,'0')).join('')
}
const versionParts=v=>v.split('.').map(Number);
function newer(a,b){const x=versionParts(a),y=versionParts(b);for(let i=0;i<3;i++){if((x[i]||0)>(y[i]||0))return true;if((x[i]||0)<(y[i]||0))return false}return false}
async function checkGitHub(silent=false){
  const msg=document.getElementById('githubMessage'),button=document.getElementById('checkGitHub'),install=document.getElementById('installGitHub');
  if(!silent)msg.textContent=T[lang].checkingUpdates;
  button.disabled=true;
  try{
    const response=await fetch(GITHUB_MANIFEST+'?t='+Date.now(),{cache:'no-store'});
    if(!response.ok)throw Error('HTTP '+response.status);
    const m=await response.json();
    if(!/^\d+\.\d+(?:\.\d+)?$/.test(m.version)||!/^K2_Status_Light_v[0-9_]+_OTA\.bin$/.test(m.file)||!Number.isInteger(m.size)||m.size<100000||m.size>1900000||!(/^[a-f0-9]{64}$/i.test(m.sha256)))throw Error('Invalid manifest');
    const previous=availableUpdate?.version;availableUpdate=newer(m.version,lastStatus.version||'0.0')?m:null;
    install.hidden=!availableUpdate;
    msg.textContent=availableUpdate?T[lang].newVersion+' '+m.version:T[lang].noUpdate;
    if(availableUpdate&&previous!==m.version)toast(msg.textContent);
  }catch(e){availableUpdate=null;install.hidden=true;msg.textContent=T[lang].githubUnavailable;if(!silent)toast(msg.textContent,true)}
  finally{button.disabled=false}
}
async function uploadFirmware(file,button){
  button.disabled=true;const f=new FormData();f.append('firmware',file,file.name);
  const msg=document.getElementById('fwMessage'),began=Date.now(),ticker=setInterval(()=>{msg.textContent=T[lang].waiting+' '+Math.floor((Date.now()-began)/1000)+' s'},1000);
  msg.textContent=T[lang].restarting;let confirmed=false;
  try{try{const r=await fetch('/api/update',{method:'POST',body:f});if(!r.ok)throw Error(await r.text());confirmed=true}catch(err){if(err instanceof TypeError){msg.textContent=T[lang].waiting}else throw err}await waitForRestart(confirmed,lastStatus.version)}
  catch(err){msg.textContent=T[lang].updateFailed+': '+localError(err.message);toast(msg.textContent,true)}
  finally{clearInterval(ticker);button.disabled=false}
}
document.getElementById('checkGitHub').onclick=()=>checkGitHub();
document.getElementById('installGitHub').onclick=async e=>{
  const m=availableUpdate;if(!m||!confirm(T[lang].githubConfirm.replace('{version}',m.version)))return;
  const button=e.target,msg=document.getElementById('githubMessage');button.disabled=true;
  try{
    msg.textContent=T[lang].downloadFirmware;
    const url='https://raw.githubusercontent.com/TomaszK00/Creality-K2-Status-Light/main/Software/'+m.file;
    const response=await fetch(url+'?t='+Date.now(),{cache:'no-store'});
    if(!response.ok)throw Error('HTTP '+response.status);
    const bytes=new Uint8Array(await response.arrayBuffer());
    if(bytes.length!==m.size||bytes[0]!==0xe9||sha256(bytes)!==m.sha256.toLowerCase())throw Error(T[lang].invalidFirmware);
    await uploadFirmware(new File([bytes],m.file,{type:'application/octet-stream'}),button);
  }catch(err){msg.textContent=err.message;toast(msg.textContent,true)}
  finally{button.disabled=false}
};
document.getElementById('fwform').onsubmit=async e=>{
  e.preventDefault();const file=document.getElementById('bin').files[0];
  if(!file||!file.name.toLowerCase().endsWith('.bin')){document.getElementById('fwMessage').textContent=T[lang].chooseBin;return}
  if(confirm(T[lang].uploadConfirm))await uploadFirmware(file,e.target.querySelector('button'));
};

setLang(T[localStorage.getItem('k2lang')]?localStorage.getItem('k2lang'):'en');refresh().then(()=>setTimeout(()=>checkGitHub(true),2500));setInterval(refresh,1200);setInterval(()=>checkGitHub(true),30*60*1000);setInterval(()=>paintStatus(lastStatus),70);
</script></body></html>
)HTML";

String normalizeColor(String c, const String& fallback) {
  if(c.length()!=7 || c[0]!='#')return fallback;
  for(int i=1;i<7;i++)if(!isxdigit((unsigned char)c[i]))return fallback;
  c.toLowerCase();return c;
}
uint32_t color24(const String& h) {return strtoul(h.c_str()+1,nullptr,16);}
void loadSettings(){
  prefs.begin("k2led",true);
  ssid=prefs.getString("ssid","");wifiPassword=prefs.getString("pass","");
  printerIP=prefs.getString("ip","192.168.1.9");printerPort=prefs.getUShort("port",7125);
  intervalMs=constrain(prefs.getInt("intvl",500),100,10000);
  activeLedCount=prefs.getInt("ledcnt",24)==12?12:24;
  int oldBright=constrain(prefs.getInt("bright",65),1,100);
  int oldPeriod=constrain(prefs.getInt("pulsems",1400),200,10000);
  uint8_t oldMask=prefs.isKey("pmask")?prefs.getUChar("pmask",0):0;
  bool oldLast=prefs.getBool("plast",false);
  if(!prefs.isKey("pmask")){String mode=prefs.getString("pulsemode","off");oldMask=mode=="all"?0x1f:(mode=="last"?1:0);oldLast=mode=="last";}
  for(int i=0;i<6;i++){
    String key=String(i);
    String oldColor=i==0?prefs.getString("color",DEFAULT_ROW_COLORS[0]):prefs.getString((String("c")+i).c_str(),DEFAULT_ROW_COLORS[i]);
    rowColors[i]=normalizeColor(prefs.getString((String("rc")+key).c_str(),oldColor),DEFAULT_ROW_COLORS[i]);
    rowBrightness[i]=constrain(prefs.getInt((String("rb")+key).c_str(),oldBright),1,100);
    rowPulse[i]=prefs.getBool((String("re")+key).c_str(),(oldMask&(1<<i))!=0);
    rowStyle[i]=constrain((int)prefs.getUChar((String("rs")+key).c_str(),(i==0&&oldLast)?1:0),0,5);
    rowPeriod[i]=constrain(prefs.getInt((String("rp")+key).c_str(),oldPeriod),200,10000);
  }
  prefs.end();
}
void saveNetwork(){prefs.begin("k2led",false);prefs.putString("ssid",ssid);prefs.putString("pass",wifiPassword);prefs.putString("ip",printerIP);prefs.putUShort("port",printerPort);prefs.end();}
void saveLighting(){prefs.begin("k2led",false);prefs.putInt("intvl",intervalMs);prefs.putInt("ledcnt",activeLedCount);for(int i=0;i<6;i++){String key=String(i);prefs.putString((String("rc")+key).c_str(),rowColors[i]);prefs.putInt((String("rb")+key).c_str(),rowBrightness[i]);prefs.putBool((String("re")+key).c_str(),rowPulse[i]);prefs.putUChar((String("rs")+key).c_str(),rowStyle[i]);prefs.putInt((String("rp")+key).c_str(),rowPeriod[i]);}prefs.end();}
void addRows(JsonDocument& d){for(int i=0;i<6;i++){const char* name=i==0?"progress":stateNames[i];d["rows"][name]["color"]=rowColors[i];d["rows"][name]["brightness"]=rowBrightness[i];d["rows"][name]["pulse"]=rowPulse[i];d["rows"][name]["period"]=rowPeriod[i];d["rows"][name]["style"]=rowStyle[i];}}

int statusIndex(String st){if(st=="printing")return 0;if(st=="heating")return 1;if(st=="paused")return 2;if(st=="complete")return 3;if(st=="error")return 4;return 5;}
String normalState(String s){s.toLowerCase();if(s=="complete"||s=="completed")return "complete";if(s=="printing")return "printing";if(s=="paused")return "paused";if(s=="error"||s=="cancelled")return "error";if(s=="heating")return "heating";return "standby";}
void updateLEDs(){
  if(!LED_ENABLED)return;
  String st=simEnabled?String(stateNames[simStatus]):normalState(printerState);
  if(!simEnabled&&!printerConnected)st="standby";
  int idx=statusIndex(st),pairs=activeLedCount/2;
  int count=st=="printing"?(int)ceilf((simEnabled?simProgress:printerProgress*100.0f)*pairs/100.0f):(st=="standby"&&!rowPulse[idx]?0:pairs);
  count=constrain(count,0,pairs);
  uint32_t rgb=color24(rowColors[idx]);uint8_t r=(rgb>>16)&255,g=(rgb>>8)&255,b=rgb&255;
  float cycle=(millis()%rowPeriod[idx])/(float)rowPeriod[idx];
  float scale=0.625f-0.375f*cosf(6.2831853f*cycle);
  float travel=cycle*2.0f*fmaxf(0,count-1);float head=travel<=count-1?travel:2.0f*(count-1)-travel;float centre=(count-1)/2.0f;float radius=fmaxf(0.5f,centre);float outward=1.0f-fabsf(2.0f*cycle-1.0f);float front=(rowStyle[idx]==3?outward:1.0f-outward)*radius;
  strip.setBrightness(map(rowBrightness[idx],0,100,0,255));
  for(int i=0;i<LED_COUNT;i++){
    int pair=i/2;bool lit=i<activeLedCount&&pair<count;float level=1.0f;
    if(lit&&rowPulse[idx]){
      if(rowStyle[idx]==2)level=fmaxf(0.08f,1.0f-fabsf(pair-head)/2.2f);
      else if(rowStyle[idx]==3||rowStyle[idx]==4)level=fmaxf(0.08f,1.0f-fabsf(fabsf(pair-centre)-front)/1.3f);
      else if(rowStyle[idx]==5)level=0.16f+0.84f*(0.5f+0.5f*cosf(6.2831853f*(pair/fmaxf(1,count-1)-cycle)));
      else if(rowStyle[idx]==0||(rowStyle[idx]==1&&pair==count-1))level=scale;
    }
    strip.setPixelColor(i,lit?strip.Color((uint8_t)(r*level),(uint8_t)(g*level),(uint8_t)(b*level),0):strip.Color(0,0,0,0));
  }
  strip.show();
}

void startNetwork(){
  WiFi.mode(WIFI_STA);
  if(ssid.length()){
    WiFi.begin(ssid.c_str(),wifiPassword.c_str());
    Serial.print("Connecting WiFi");
    for(int i=0;i<40 && WiFi.status()!=WL_CONNECTED;i++){delay(250);Serial.print('.');}
  }
  if(WiFi.status()==WL_CONNECTED){Serial.println("\nPanel: http://"+WiFi.localIP().toString());if(MDNS.begin("k2-led"))Serial.println("mDNS: http://k2-led.local");}
  else{apMode=true;WiFi.mode(WIFI_AP_STA);WiFi.softAP(AP_NAME,AP_PASSWORD);Serial.println("\nSetup AP: K2-LED-Setup · http://192.168.4.1");}
}
void pollPrinter(){
  if(apMode || WiFi.status()!=WL_CONNECTED){printerConnected=false;lastError="No printer connection (setup AP)";return;}
  WiFiClient client;HTTPClient http;
  String url="http://"+printerIP+":"+String(printerPort)+"/printer/objects/query?print_stats&virtual_sdcard";
  http.setTimeout(1700);
  if(!http.begin(client,url)){printerConnected=false;lastError="Invalid Moonraker URL";return;}
  int response=http.GET();if(response!=200){printerConnected=false;lastError="HTTP "+String(response);http.end();return;}
  JsonDocument doc;DeserializationError err=deserializeJson(doc,http.getStream());http.end();
  if(err){printerConnected=false;lastError=String("JSON: ")+err.c_str();return;}
  JsonVariant status=doc["result"]["status"];
  if(status["print_stats"].isNull()||status["virtual_sdcard"].isNull()){printerConnected=false;lastError="Missing printer fields";return;}
  printerState=status["print_stats"]["state"].as<String>();printerFile=status["print_stats"]["filename"].as<String>();
  printerProgress=constrain(status["virtual_sdcard"]["progress"].as<float>(),0.f,1.f);
  printerConnected=true;lastError="";
}
void jsonReply(int code, JsonDocument& d){String s;serializeJson(d,s);server.send(code,"application/json",s);}
void routes(){
  server.on("/",HTTP_GET,[](){server.sendHeader("Cache-Control","no-store");server.send_P(200,"text/html; charset=utf-8",PAGE);});
  server.on("/api/status",HTTP_GET,[](){JsonDocument d;d["version"]="2.8";d["connected"]=printerConnected;d["ap"]=apMode;d["state"]=normalState(printerState);d["progress"]=printerProgress;d["filename"]=printerFile;d["error"]=lastError;d["ssid"]=ssid;d["ip"]=printerIP;d["port"]=printerPort;d["interval"]=intervalMs;d["ledCount"]=activeLedCount;d["simLoop"]=simLoop;d["sim"]=simEnabled;d["simState"]=stateNames[simStatus];d["simProgress"]=simProgress;d["simRunning"]=simRun;addRows(d);jsonReply(200,d);});
  server.on("/api/wifi/scan",HTTP_GET,[](){int n=WiFi.scanNetworks(false,true);JsonDocument d;JsonArray a=d["networks"].to<JsonArray>();for(int i=0;i<n && i<35;i++){String name=WiFi.SSID(i);if(name.isEmpty())continue;JsonObject net=a.add<JsonObject>();net["ssid"]=name;net["rssi"]=WiFi.RSSI(i);net["secure"]=WiFi.encryptionType(i)!=WIFI_AUTH_OPEN;}WiFi.scanDelete();jsonReply(200,d);});
  server.on("/api/network",HTTP_POST,[](){String newSSID=server.arg("ssid"),newIP=server.arg("ip");newSSID.trim();newIP.trim();int port=server.arg("port").toInt();IPAddress parsed;if(!parsed.fromString(newIP)||port<1||port>65535||newSSID.length()>32){server.send(400,"text/plain","Invalid IP, port or SSID");return;}bool changed=(ssid!=newSSID||server.arg("pass").length()>0);ssid=newSSID;printerIP=newIP;printerPort=port;if(server.arg("pass").length())wifiPassword=server.arg("pass");saveNetwork();server.send(200,"text/plain; charset=utf-8",changed?"Saved. Press RESET to reconnect to the new Wi-Fi. / Zapisano. Naciśnij RESET.":"Saved / Zapisano");});
  server.on("/api/lighting",HTTP_POST,[](){
    int leds=server.arg("ledCount").toInt();
    if(leds!=12&&leds!=24){server.send(400,"text/plain","Invalid LED count");return;}
    String colors[6];uint8_t br[6],styles[6];bool enabled[6];uint16_t periods[6];
    for(int i=0;i<6;i++){
      String id=i==0?"progress":String(stateNames[i]);
      colors[i]=normalizeColor(server.arg("c_"+id),"");int b=server.arg("b_"+id).toInt(),p=server.arg("pp_"+id).toInt(),style=server.arg("ps_"+id).toInt();
      if(colors[i].isEmpty()||b<1||b>100||p<200||p>10000||style<0||style>5){server.send(400,"text/plain","Invalid LED row: "+id);return;}
      br[i]=b;periods[i]=p;styles[i]=style;enabled[i]=server.hasArg("pe_"+id);
    }
    activeLedCount=leds;
    for(int i=0;i<6;i++){rowColors[i]=colors[i];rowBrightness[i]=br[i];rowPeriod[i]=periods[i];rowStyle[i]=styles[i];rowPulse[i]=enabled[i];}
    saveLighting();updateLEDs();server.send(200,"text/plain","Saved");
  });
  server.on("/api/lighting/defaults",HTTP_POST,[](){
    activeLedCount=24;intervalMs=500;
    for(int i=0;i<6;i++){rowColors[i]=DEFAULT_ROW_COLORS[i];rowBrightness[i]=65;rowPulse[i]=false;rowStyle[i]=0;rowPeriod[i]=1400;}
    saveLighting();updateLEDs();JsonDocument d;d["ok"]=true;d["ledCount"]=activeLedCount;d["interval"]=intervalMs;addRows(d);jsonReply(200,d);
  });
  server.on("/api/simulation",HTTP_POST,[](){simEnabled=server.arg("enabled")=="1";simStatus=statusIndex(server.arg("status"));simProgress=constrain(server.arg("progress").toInt(),0,100);simLoop=server.arg("loop")=="1";if(server.hasArg("run")){simRun=simEnabled&&server.arg("run")=="1";lastSimulationStep=millis();}if(!simEnabled)simRun=false;updateLEDs();JsonDocument d;d["ok"]=true;jsonReply(200,d);});
  server.on("/api/update",HTTP_POST,[](){bool ok=!Update.hasError()&&updateError.isEmpty();server.send(ok?200:500,"text/plain",ok?"OK":("Update failed: "+updateError));delay(350);if(ok)ESP.restart();},[](){HTTPUpload& upload=server.upload();if(upload.status==UPLOAD_FILE_START){updateError="";if(!upload.filename.endsWith(".bin")){updateError="Expected .bin";return;}if(!Update.begin(UPDATE_SIZE_UNKNOWN,U_FLASH))updateError=Update.errorString();}else if(upload.status==UPLOAD_FILE_WRITE){if(updateError.isEmpty()&&Update.write(upload.buf,upload.currentSize)!=upload.currentSize)updateError=Update.errorString();}else if(upload.status==UPLOAD_FILE_END){if(updateError.isEmpty()&&!Update.end(true))updateError=Update.errorString();}else if(upload.status==UPLOAD_FILE_ABORTED){Update.abort();updateError="Aborted";}});
}
void setup(){pinMode(STATUS_LED_PIN,OUTPUT);digitalWrite(STATUS_LED_PIN,HIGH);Serial.begin(115200);delay(450);loadSettings();if(LED_ENABLED){strip.begin();strip.clear();strip.show();}startNetwork();routes();server.begin();Serial.println("K2 Status Light v2.7 web server ready");}
void loop(){
  server.handleClient();
  uint32_t now=millis();
  // Two short blue flashes, then a longer pause; onboard LED is active LOW.
  uint32_t beat=now%1000;
  digitalWrite(STATUS_LED_PIN,(beat<100||(beat>=220&&beat<320))?LOW:HIGH);
  if(now-lastPoll>2200){lastPoll=now;if(!simEnabled){pollPrinter();updateLEDs();}}
  if(simRun&&now-lastSimulationStep>=(uint32_t)intervalMs){
    lastSimulationStep=now;
    if(simProgress>=100){if(simLoop)simProgress=0;else simRun=false;}
    else {simProgress=min(100,simProgress+9);if(simProgress>=100&&!simLoop)simRun=false;}
    updateLEDs();
  }
  if(rowPulse[statusIndex(simEnabled?String(stateNames[simStatus]):(!printerConnected?String("standby"):normalState(printerState)))]&&now-lastPulseFrame>=40){lastPulseFrame=now;updateLEDs();}
  delay(2);
}

